## examples/01_basic/color_test/sdkconfig.defaults
```kconfig
# ESP-IDF default configuration for color_test example

# HUB75 Panel Settings (typical 64x64 panel)
CONFIG_HUB75_PANEL_WIDTH=64
CONFIG_HUB75_PANEL_HEIGHT=64
CONFIG_HUB75_SCAN_1_32=y
CONFIG_HUB75_WIRING_STANDARD=y
CONFIG_HUB75_DRIVER_GENERIC=y

# Single panel layout
CONFIG_HUB75_LAYOUT_ROWS=1
CONFIG_HUB75_LAYOUT_COLS=1
CONFIG_HUB75_LAYOUT_HORIZONTAL=y

# Performance settings - use 8-bit for best color accuracy
CONFIG_HUB75_BIT_DEPTH_8=y
CONFIG_HUB75_CLK_10MHZ=y
CONFIG_HUB75_MIN_REFRESH_RATE=60
CONFIG_HUB75_BRIGHTNESS=255

# Component features
CONFIG_HUB75_DOUBLE_BUFFER=n
CONFIG_HUB75_TEMPORAL_DITHER=n
CONFIG_HUB75_IRAM_OPTIMIZATION=y

# Board preset (user should configure via menuconfig)
CONFIG_HUB75_BOARD_CUSTOM=y
```

## examples/01_basic/profiler/sdkconfig.defaults
```kconfig
# ESP-IDF default configuration for profiler example
# NOTE: This example only works on Xtensa chips (ESP32, ESP32-S2, ESP32-S3)

# Use performance optimization for accurate profiling (-O2)
CONFIG_COMPILER_OPTIMIZATION_PERF=y

# HUB75 Panel Settings (typical 64x64 panel)
CONFIG_HUB75_PANEL_WIDTH=64
CONFIG_HUB75_PANEL_HEIGHT=64
CONFIG_HUB75_SCAN_1_32=y
CONFIG_HUB75_WIRING_STANDARD=y
CONFIG_HUB75_DRIVER_GENERIC=y

# Single panel layout
CONFIG_HUB75_LAYOUT_ROWS=1
CONFIG_HUB75_LAYOUT_COLS=1
CONFIG_HUB75_LAYOUT_HORIZONTAL=y

# Performance settings
CONFIG_DEPTH_8=y
CONFIG_HUB75_CLK_10MHZ=y
CONFIG_HUB75_MIN_REFRESH_RATE=60
CONFIG_HUB75_BRIGHTNESS=255

# Component features
CONFIG_HUB75_DOUBLE_BUFFER=n
CONFIG_HUB75_TEMPORAL_DITHER=n
CONFIG_HUB75_IRAM_OPTIMIZATION=y

# Board preset (user should configure via menuconfig)
CONFIG_HUB75_BOARD_CUSTOM=y
```
