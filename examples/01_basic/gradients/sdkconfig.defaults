## examples/03_lvgl/simple_demo/sdkconfig.defaults
```kconfig
# ESP-IDF default configuration for LVGL demo example

# HUB75 Panel Settings
CONFIG_HUB75_PANEL_WIDTH=64
CONFIG_HUB75_PANEL_HEIGHT=64
CONFIG_HUB75_WIRING_STANDARD=y
CONFIG_HUB75_DRIVER_GENERIC=y

# Single panel layout
CONFIG_HUB75_LAYOUT_ROWS=1
CONFIG_HUB75_LAYOUT_COLS=1
CONFIG_HUB75_LAYOUT_HORIZONTAL=y

# Performance settings
CONFIG_HUB75_BIT_DEPTH_8=y
CONFIG_HUB75_CLK_10MHZ=y
CONFIG_HUB75_MIN_REFRESH_RATE=60
CONFIG_HUB75_BRIGHTNESS=128

# Component features
CONFIG_HUB75_DOUBLE_BUFFER=n

# Board preset
CONFIG_HUB75_BOARD_CUSTOM=y

# LVGL Configuration
CONFIG_LV_COLOR_DEPTH_16=y
CONFIG_LV_USE_PERF_MONITOR=n
CONFIG_LV_USE_MEM_MONITOR=n

# FreeRTOS Configuration
CONFIG_FREERTOS_HZ=1000
```

## main/Kconfig.projbuild
```kconfig
# SPDX-FileCopyrightText: 2025 Stuart Parmenter
# SPDX-License-Identifier: MIT

menu "HUB75 Example Selection"

    choice EXAMPLE_SELECTION
        prompt "Example to Build"
        default EXAMPLE_SMOKE_TEST
        help
            Select which example to build in the main/ directory.

            Examples are also available in examples/ and can be built standalone
            by navigating to the example directory and running 'idf.py build'.

            All HUB75 hardware configuration (pins, panel settings, etc.) is
            available under "Component config → HUB75 RGB LED Matrix Driver".

        config EXAMPLE_SMOKE_TEST
            bool "Smoke Test (Quick Validation)"
            help
                Simple colored squares in corners + center cross.
                Fast build for quick hardware validation.

        config EXAMPLE_SIMPLE_COLORS
            bool "01_basic/simple_colors"
            help
                RGB corner squares, white square, cyan cross.
                Basic pixel drawing demonstration.

        config EXAMPLE_GRADIENTS
            bool "01_basic/gradients"
            help
                Smooth color transitions (horizontal, vertical, radial).
                Demonstrates color blending and gradient rendering.

        config EXAMPLE_BRIGHTNESS
            bool "01_basic/brightness"
            help
                Brightness control: fade in/out, pulse animation.
                Shows runtime brightness adjustment.

        config EXAMPLE_COLOR_TEST
            bool "01_basic/color_test"
            help
                Cycles color patterns to diagnose channel order,
                gamma and per-channel problems.

        config EXAMPLE_LAYOUT_DEMO
            bool "02_multi_panel/layout_demo"
            help
                Multi-panel layout demonstration (horizontal, serpentine, zigzag).
                Set the layout under the HUB75 component's panel layout options.

        config EXAMPLE_LVGL_DEMO
            bool "03_lvgl/simple_demo"
            help
                LVGL integration: labels, buttons, brightness slider.
                Requires LVGL dependency (pulled via idf_component.yml).
    endchoice

endmenu
```
